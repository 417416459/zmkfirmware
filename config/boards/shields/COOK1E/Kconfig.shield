## config/boards/shields/COOK1E/Kconfig.shield
```kconfig
# Copyright (c) 2020 Pete Johanson
# SPDX-License-Identifier: MIT

config SHIELD_COOK1E_LEFT
    def_bool $(shields_list_contains,COOK1E_left)

config SHIELD_COOK1E_RIGHT
    def_bool $(shields_list_contains,COOK1E_right)
```
